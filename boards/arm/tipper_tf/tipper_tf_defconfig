## boards/arm/tipper_tf/tipper_tf_defconfig
```kconfig
# Copyright (c) 2021 weteor
# SPDX-License-Identifier: MIT

CONFIG_SOC_SERIES_NRF52X=y
CONFIG_SOC_NRF52840_QIAA=y
CONFIG_BOARD_TIPPER_TF=y

CONFIG_BUILD_OUTPUT_UF2=y

#enable MPU
CONFIG_ARM_MPU=y

#enable GPIO
CONFIG_GPIO=y

CONFIG_ZMK_SLEEP=n
CONFIG_ZMK_DISPLAY=y
CONFIG_CUSTOM_WIDGET_BATTERY_STATUS=y
CONFIG_ZMK_WIDGET_BATTERY_STATUS=n
CONFIG_CUSTOM_WIDGET_OUTPUT_STATUS=y
CONFIG_ZMK_WIDGET_OUTPUT_STATUS=n

CONFIG_CUSTOM_WIDGET_PROFILE_STATUS=y

CONFIG_LVGL_USE_THEME_MONO=y
CONFIG_LVGL_THEME_DEFAULT_COLOR_PRIMARY_RED=n
CONFIG_LVGL_THEME_DEFAULT_COLOR_SECONDARY_RED=n
CONFIG_LVGL_THEME_DEFAULT_COLOR_PRIMARY_BLACK=y
CONFIG_LVGL_THEME_DEFAULT_COLOR_SECONDARY_WHITE=y

CONFIG_USE_DT_CODE_PARTITION=y

CONFIG_MPU_ALLOW_FLASH_WRITE=y
CONFIG_NVS=y
CONFIG_SETTINGS_NVS=y
CONFIG_FLASH=y
CONFIG_FLASH_PAGE_LAYOUT=y
CONFIG_FLASH_MAP=y

CONFIG_LOG=n
CONFIG_ZMK_USB_LOGGING=y
# CONFIG_ZMK_LOG_LEVEL_DBG=y
#CONFIG_LOG_BUFFER_SIZE=65536
#CONFIG_LOG_STRDUP_BUF_COUNT=160
# CONFIG_SPI_LOG_LEVEL_DBG=y
# CONFIG_DISPLAY_LOG_LEVEL_DBG=y
# CONFIG_LVGL_LOG_LEVEL_DBG=y
# CONFIG_LVGL_USE_DEBUG=y
```

## config/west.yml
```yaml
manifest:
  remotes:
    - name: zmkfirmware
      url-base: https://github.com/weteor
    - name: Marbelymarble
      url-base: https://github.com/Marbelymarble
  projects:
    - name: zmk
      remote: zmkfirmware
      revision: Tipper_TF_rev2
      import: app/west.yml
  self:
    path: config
```
